## config/boards/shields/lowsodium62/Kconfig.defconfig
```kconfig
# Copyright (c) 2022 Derek Schmell
# SPDX-License-Identifier: MIT
 
 
if SHIELD_LOWSODIUM62_LEFT

config ZMK_KEYBOARD_NAME
	default "lowsodium62"

config ZMK_SPLIT_BLE_ROLE_CENTRAL
	default y

endif

if SHIELD_LOWSODIUM62_LEFT || SHIELD_LOWSODIUM62_RIGHT

config ZMK_SPLIT
	default y
	
endif
```
